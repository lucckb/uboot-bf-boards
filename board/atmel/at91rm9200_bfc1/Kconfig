## board/atmel/at91rm9200_bfc1/Kconfig
```kconfig
if TARGET_AT91RM9200_BFC1

config SYS_BOARD
	default "at91rm9200_bfc1"

config SYS_VENDOR
	default "BoFF"

config SYS_CONFIG_NAME
	default "at91rm9200_bfc1"
endif
```

## configs/at91rm9200_bfc1_defconfig
```kconfig
CONFIG_ARM=y
CONFIG_ARCH_AT91=y
CONFIG_TARGET_AT91RM9200_BFC1=y
CONFIG_SYS_PROMPT="boff> "
# CONFIG_CMD_FPGA is not set
# CONFIG_CMD_SETEXPR is not set
```
